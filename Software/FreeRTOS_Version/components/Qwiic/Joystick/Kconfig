## Software/FreeRTOS_Version/components/Qwiic/Joystick/Kconfig
```kconfig
menu "Qwiic Joystick configuration"

    config QWIIC_JOYSTICK_PERIPHERAL_ADDRESS
        hex "Specify the address of the Qwiic Joystick Peripheral"
        default 0x20
        help
            Pick the address of the Qwiic Joystick Peripheral

endmenu  # Qwiic configurations
```

## Software/FreeRTOS_Version/components/Qwiic/QwiicController/Kconfig
```kconfig
menu "Qwiic configuration"

    config QWIIC_SDA_PIN
        int "Specify the GPIO Pin to use for SDA on the Qwiic System"
        default 23
        help
            Pick the GPIO pin used for the SDA (serial data wire)

    config QWIIC_SCL_PIN
        int "Specify the GPIO Pin used for SCL on the Qwiic System"
        default 22
        help
            Pick the GPIO pin used for the SCL (serial clock wire)
    config QWIIC_CONTROLLER_FREQUENCY
            int "Controller Frequency"
            default 100000
            help
                I2C Speed of Qwiic Controller.
    config QWIIC_PORT_NUM
            int "Port Number"
            default 0
            help
                Port number for Qwiic Controller.

endmenu  # Qwiic configurations
```

## Software/FreeRTOS_Version/components/UART/Debugger/Kconfig
```kconfig
menu "UART Debugger library"

    config UART_ENABLE_DEBUGGER
        bool "Print Debugging Output to UART"
        default n
        help
            If set, the microcontroller will send Debugging data via the UART

endmenu # "UART Debugger library"
```

## Software/components/freertos/buttons/Kconfig
```kconfig
menu "Button configuration"

    config BUTTONS_DEBOUNCE_MS
    int "Specify the debounce time to use for the buttons in milliseconds"
    range 0 1000
    default 100
    help
       The debounce time used for handling button interrupts to prevent accidental triggers
    

endmenu  # Button configuration
```
